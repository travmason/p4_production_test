## components/esp-bsp/bsp/esp32_p4_function_ev_board/Kconfig
```kconfig
menu "Board Support Package (ESP32-P4)"

    config BSP_ERROR_CHECK
        bool "Enable error check in BSP"
        default y
        help
            Error check assert the application before returning the error code.
            
    menu "I2C"
        config BSP_I2C_NUM
            int "I2C peripheral index"
            default 1
            range 0 1
            help
                ESP32P4 has two I2C peripherals, pick the one you want to use.

        config BSP_I2C_FAST_MODE
            bool "Enable I2C fast mode"
            default y
            help
                I2C has two speed modes: normal (100kHz) and fast (400kHz).

        config BSP_I2C_CLK_SPEED_HZ
            int
            default 400000 if BSP_I2C_FAST_MODE
            default 100000
    endmenu

    menu "I2S"
        config BSP_I2S_NUM
            int "I2S peripheral index"
            default 1
            range 0 2
            help
                ESP32P4 has three I2S peripherals, pick the one you want to use.
    endmenu

    menu "uSD card - Virtual File System"
        config BSP_SD_FORMAT_ON_MOUNT_FAIL
            bool "Format uSD card if mounting fails"
            default n
            help
                The SDMMC host will format (FAT) the uSD card if it fails to mount the filesystem.

        config BSP_SD_MOUNT_POINT
            string "uSD card mount point"
            default "/sdcard"
            help
                Mount point of the uSD card in the Virtual File System

    endmenu

    menu "SPIFFS - Virtual File System"
        config BSP_SPIFFS_FORMAT_ON_MOUNT_FAIL
            bool "Format SPIFFS if mounting fails"
            default n
            help
                Format SPIFFS if it fails to mount the filesystem.

        config BSP_SPIFFS_MOUNT_POINT
            string "SPIFFS mount point"
            default "/spiffs"
            help
                Mount point of SPIFFS in the Virtual File System.

        config BSP_SPIFFS_PARTITION_LABEL
            string "Partition label of SPIFFS"
            default "storage"
            help
                Partition label which stores SPIFFS.

        config BSP_SPIFFS_MAX_FILES
            int "Max files supported for SPIFFS VFS"
            default 5
            help
                Supported max files for SPIFFS in the Virtual File System.
    endmenu

    menu "Display"
        config BSP_LCD_DPI_BUFFER_NUMS
            int "Set number of frame buffers"
            default 1
            range 1 3
            help
                Let DPI LCD driver create a specified number of frame-size buffers. Only when it is set to multiple can the avoiding tearing be turned on.

        config BSP_DISPLAY_LVGL_AVOID_TEAR
            bool "Avoid tearing effect"
            depends on BSP_LCD_DPI_BUFFER_NUMS > 1
            default "n"
            help
                Avoid tearing effect through LVGL buffer mode and double frame buffers of RGB LCD. This feature is only available for RGB LCD.

        choice BSP_DISPLAY_LVGL_MODE
            depends on BSP_DISPLAY_LVGL_AVOID_TEAR
            prompt "Select LVGL buffer mode"
            default BSP_DISPLAY_LVGL_FULL_REFRESH
            config BSP_DISPLAY_LVGL_FULL_REFRESH
                bool "Full refresh"
            config BSP_DISPLAY_LVGL_DIRECT_MODE
                bool "Direct mode"
        endchoice
            
        config BSP_DISPLAY_BRIGHTNESS_LEDC_CH
        int "LEDC channel index"
        default 1
        range 0 7
        help
            LEDC channel is used to generate PWM signal that controls display brightness.
            Set LEDC index that should be used.

        choice BSP_LCD_COLOR_FORMAT
            prompt "Select LCD color format"
            default BSP_LCD_COLOR_FORMAT_RGB565
            help
                Select the LCD color format RGB565/RGB888.

            config BSP_LCD_COLOR_FORMAT_RGB565
                bool "RGB565"
            config BSP_LCD_COLOR_FORMAT_RGB888
                bool "RGB888"
        endchoice   
            
        config BSP_LCD_USE_DMA2D
            bool "Select whether to use DMA2D"
            default "y"
            help
                Select whether to use DMA2D to draw the bitmap.

        choice BSP_LCD_TYPE
            prompt "Select LCD type"
            default BSP_LCD_TYPE_1024_600
            help
                Select the LCD.

            config BSP_LCD_TYPE_1024_600
                bool "LCD 7-inch 1024x600 - ek79007"
            config BSP_LCD_TYPE_1280_800
                bool "LCD 1280x800 - ili9881c"
            config BSP_LCD_TYPE_HDMI
                bool "HDMI - lt8912b"
        endchoice    
            
        choice BSP_LCD_HDMI_RESOLUTION
            depends on BSP_LCD_TYPE_HDMI
            prompt "Select HDMI resolution"
            default BSP_LCD_HDMI_1280x720_60HZ
            help
                Select the HDMI resolution.

            config BSP_LCD_HDMI_800x600_60HZ
                bool "800x600@60HZ"
            config BSP_LCD_HDMI_1280x720_60HZ
                bool "1280x720@60HZ"
            config BSP_LCD_HDMI_1280x800_60HZ
                bool "1280x800@60HZ"
            config BSP_LCD_HDMI_1920x1080_30HZ
                bool "1920x1080@30HZ"
            config BSP_LCD_HDMI_1600x720_60HZ
                bool "1600x720@60HZ (bar panel, trimmed blanking)"
                help
                    For 1600x720 bar-type panels such as the Waveshare
                    10.4HP-CAPQLED. The P4 can only produce 80 MHz near this
                    mode (PLL_F240M / 3), so blanking is trimmed to land on
                    60.05 Hz.
            config BSP_LCD_HDMI_1600x720_VENDOR
                bool "1600x720@55.8HZ (bar panel, vendor blanking)"
                help
                    Same panels, but using the blanking Waveshare publishes for
                    the Raspberry Pi. Their 87 MHz pixel clock is unreachable on
                    the P4, so this runs at 55.8 Hz. Try this if the panel's
                    scaler will not lock onto the trimmed 60 Hz timing.
        endchoice

        config BSP_LCD_MIPI_DSI_LANE_BITRATE_MBPS
            int "MIPI-DSI lane bit rate (Mbps)"
            default 1200 if BSP_LCD_HDMI_1600x720_60HZ || BSP_LCD_HDMI_1600x720_VENDOR
            default 1000
            range 80 1500
            help
                Bit rate per MIPI-DSI data lane. Must be greater than
                pclk * bits_per_pixel / number_of_lanes, with headroom for DSI
                packet overhead. The ESP32-P4 D-PHY tops out at 1500 Mbps.

    endmenu
    
endmenu
```

## gps_node/main/Kconfig.projbuild
```kconfig
menu "GPS node"

    choice GPS_SOURCE
        prompt "GPS receiver"
        default GPS_SOURCE_DRAGY
        help
            Where the node gets its fixes. Either way the same CAN frames go
            to the dashboard.

        config GPS_SOURCE_DRAGY
            bool "Dragy Pro over Bluetooth"
        config GPS_SOURCE_UBLOX
            bool "u-blox module on a UART"
    endchoice

    config GPS_CAN_TX_GPIO
        int "CAN TX GPIO (to the transceiver's TXD)"
        default 5

    config GPS_CAN_RX_GPIO
        int "CAN RX GPIO (from the transceiver's RXD)"
        default 4

    config GPS_CAN_BITRATE
        int "CAN bit rate"
        default 500000
        help
            Must match the ECU and the dashboard. 125000, 250000, 500000 or
            1000000.

    config GPS_UBLOX_RX_GPIO
        int "u-blox UART: GPIO receiving from the module's TX"
        depends on GPS_SOURCE_UBLOX
        default 18

    config GPS_UBLOX_TX_GPIO
        int "u-blox UART: GPIO sending to the module's RX (-1 = not wired)"
        depends on GPS_SOURCE_UBLOX
        default 17

    config GPS_UBLOX_BAUD
        int "u-blox UART baud rate"
        depends on GPS_SOURCE_UBLOX
        default 115200

endmenu
```
